// SPDX-License-Identifier: GPL-2.0+ OR MIT
/*
 * Apple MacBook Air (13-inch, M4, 2025) with experimental USB4 on both ports
 *
 * target-type: J713
 *
 * Opt-in DTB: ACIO0 and ACIO1 match the J713 ADT but have not been booted on
 * this board yet, so t8132-j713.dtb leaves them disabled.
 */

#include "t8132-j713.dts"
#include "t8132-usb4.dtsi"
