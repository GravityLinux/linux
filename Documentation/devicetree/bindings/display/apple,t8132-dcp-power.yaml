## Documentation/devicetree/bindings/display/apple,t8132-dcp-power.yaml
```yaml
# SPDX-License-Identifier: (GPL-2.0-only OR BSD-2-Clause)
%YAML 1.2
---
$id: http://devicetree.org/schemas/display/apple,t8132-dcp-power.yaml#
$schema: http://devicetree.org/meta-schemas/core.yaml#

title: Apple T8132 display coprocessor power resources

maintainers:
  - Niklas Sheth <hi@niklassheth.com>

description: |
  These properties describe the power resources of T8132 display engines.
  Named front-end and CPU consumers allow a driver to release the CPU before
  the front-end and its system parent. The CPU domain provider describes its
  own gate sequencer and automatic ownership; neither belongs to the display
  consumer. The panel engine may retain its existing single-domain binding.

select:
  properties:
    compatible:
      contains:
        enum:
          - apple,t8132-dcp
          - apple,t8132-dcpext
  required:
    - compatible

properties:
  power-domains:
    minItems: 1
    maxItems: 2

  power-domain-names:
    items:
      - const: fe
      - const: cpu

  apple,retirement-shared-control:
    $ref: /schemas/types.yaml#/definitions/phandle
    description:
      Shared display-request syscon. Its request, enable, notification and
      power words are at offsets 0x4000, 0xc028, 0x9c14 and 0xc020; offset
      0xc024 contains the common request configuration. Other engines' votes
      must be preserved when changing one engine's state.

  apple,retirement-shared-bits:
    $ref: /schemas/types.yaml#/definitions/uint32-array
    items:
      - description: This engine's enable and request bit
        minimum: 0
        maximum: 2
      - description: This engine's power-request bit
        minimum: 0
        maximum: 31

  apple,retirement-report:
    $ref: /schemas/types.yaml#/definitions/phandle
    description:
      PMP report client whose firmware-inherited active vote belongs to this
      engine. Release that vote after quiescing the engine and restore it
      after the CPU domain is active on restart.

dependentRequired:
  apple,retirement-shared-control:
    - apple,retirement-shared-bits
  apple,retirement-shared-bits:
    - apple,retirement-shared-control

# The display engine's transport, framebuffer and routing properties are
# outside this power-resource description.
additionalProperties: true
...
```

## Documentation/devicetree/bindings/display/apple,t8132-dp-altmode.yaml
```yaml
# SPDX-License-Identifier: (GPL-2.0-only OR BSD-2-Clause)
%YAML 1.2
---
$id: http://devicetree.org/schemas/display/apple,t8132-dp-altmode.yaml#
$schema: http://devicetree.org/meta-schemas/core.yaml#

title: Apple T8132 direct DisplayPort output routing

maintainers:
  - Niklas Sheth <hi@niklassheth.com>

description: |
  A direct DisplayPort output of an ATC can be connected to an eligible
  display coprocessor. The main engine can participate while its fixed output
  is disconnected. The source crossbar and DPTX firmware target must be
  changed together. The ATC PHY itself owns negotiated lane assignment and
  plug orientation. USB4 DP-IN adapters and tunneled displays are separate.

properties:
  compatible:
    const: apple,t8132-dp-altmode

  apple,atc-index:
    $ref: /schemas/types.yaml#/definitions/uint32
    maximum: 3
    description: DFP endpoint index in the ADT display crossbar.

  apple,display-engines:
    $ref: /schemas/types.yaml#/definitions/phandle-array
    minItems: 1
    maxItems: 3
    items:
      maxItems: 1
    description: Display engines eligible for this output, in allocation order. A fixed
      output engine is eligible only while its own connector is disconnected.

  mode-switch: true

  phys:
    maxItems: 1

  phy-names:
    const: dp-phy

  mux-controls:
    maxItems: 1

  mux-control-names:
    const: dp-xbar

  port:
    $ref: /schemas/graph.yaml#/properties/port
    description: HPD notification link to the USB-C connector.

required:
  - compatible
  - apple,atc-index
  - apple,display-engines
  - mode-switch
  - phys
  - phy-names
  - mux-controls
  - mux-control-names
  - port

additionalProperties: false
```

## Documentation/devicetree/bindings/display/apple,t8132-fixed-dp.yaml
```yaml
# SPDX-License-Identifier: (GPL-2.0-only OR BSD-2-Clause)
%YAML 1.2
---
$id: http://devicetree.org/schemas/display/apple,t8132-fixed-dp.yaml#
$schema: http://devicetree.org/meta-schemas/core.yaml#

title: Apple T8132 fixed direct DisplayPort output

maintainers:
  - Niklas Sheth <hi@niklassheth.com>

description: |
  A direct DisplayPort output of an ATC, permanently wired to one display
  engine. The crossbar source is selected once and never changes. The ATC PHY
  owns the negotiated lane assignment and plug orientation; the USB-C port
  controller reports DisplayPort HPD through the graph port. USB4 DP-IN
  adapters and tunneled displays are separate.

properties:
  compatible:
    const: apple,t8132-fixed-dp

  apple,atc-index:
    $ref: /schemas/types.yaml#/definitions/uint32
    maximum: 3
    description: DFP endpoint index in the ADT display crossbar.

  apple,display-engine:
    $ref: /schemas/types.yaml#/definitions/phandle
    description: The display engine wired to this output.

  mux-index:
    $ref: /schemas/types.yaml#/definitions/uint32
    maximum: 8
    description: Crossbar source of the display engine's stream.

  mode-switch: true

  phys:
    maxItems: 1

  phy-names:
    const: dp-phy

  mux-controls:
    maxItems: 1

  mux-control-names:
    const: dp-xbar

  port:
    $ref: /schemas/graph.yaml#/properties/port
    description: HPD notification link to the USB-C connector.

required:
  - compatible
  - apple,atc-index
  - apple,display-engine
  - mux-index
  - mode-switch
  - phys
  - phy-names
  - mux-controls
  - mux-control-names
  - port

additionalProperties: false
```

## drivers/gpu/drm/asahi/Kconfig
```kconfig
# SPDX-License-Identifier: GPL-2.0

config RUST_DRM_SCHED
	bool
	select DRM_SCHED

config RUST_DRM_GPUVM
	bool
	select DRM_GPUVM

config DRM_ASAHI
	tristate "Asahi (DRM support for Apple AGX GPUs)"
	depends on RUST
	depends on DRM=y
	depends on (ARM64 && ARCH_APPLE) || (COMPILE_TEST && !GENERIC_ATOMIC64)
	depends on MMU
	depends on IOMMU_SUPPORT
	depends on PAGE_SIZE_16KB
	depends on PM
	select APPLE_MAILBOX
	select APPLE_PMP_REPORT
	select RUST_DRM_SCHED
	select RUST_DRM_GEM_SHMEM_HELPER
	select RUST_DRM_GPUVM
	select RUST_APPLE_RTKIT
	help
	  Rust DRM driver for Apple AGX GPUs in M4, M4 Max and
	  A18 Pro (MacBook Neo). Device-tree matching selects
	  the appropriate firmware backend.
```

## sound/soc/apple/Kconfig
```kconfig
# SPDX-License-Identifier: GPL-2.0-only
menu "Apple"

config SND_SOC_APPLE_AOP_AUDIO
	tristate "AOP audio driver"
	depends on ARCH_APPLE || COMPILE_TEST
	depends on RUST
	select APPLE_AOP
	select SND_DMAENGINE_PCM
	help
	  This option enables an ASoC driver for sound devices connected to the AOP
	  co-processor on ARM Macs. This includes the built-in microphone on those
	  machines.

config SND_SOC_APPLE_NEO_MIC
	bool "Apple T8140 AOP microphone capture"
	depends on ARCH_APPLE
	select APPLE_RTKIT
	select APPLE_MAILBOX
	select SND_PCM
	help
	  Microphone capture on the MacBook Neo using the resident AOP firmware.
	  This also supplies the transport used by the protected speaker driver.

config SND_SOC_APPLE_NEO_SPEAKER
	bool "Apple T8140 protected speaker playback"
	depends on SND_SOC_APPLE_NEO_MIC && GPIOLIB
	help
	  Neo speaker PCM with a fixed 3/256 gain cap, thermal admission and
	  amplifier-first cutoff. The cap remains deliberately conservative.
config SND_SOC_APPLE_MCA
	tristate "Apple Silicon MCA driver"
	depends on ARCH_APPLE || COMPILE_TEST
	select SND_DMAENGINE_PCM
	help
	  This option enables an ASoC platform driver for MCA peripherals found
	  on Apple Silicon SoCs.

endmenu
```
