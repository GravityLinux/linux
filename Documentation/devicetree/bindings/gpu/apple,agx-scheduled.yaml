## arch/arm64/configs/m4_gpu_defconfig
```kconfig
# SPDX-License-Identifier: GPL-2.0-only
# Copyright The Gravity Linux Contributors
CONFIG_LOCALVERSION="-m4-gpu"
CONFIG_SYSVIPC=y
CONFIG_POSIX_TIMERS=y
CONFIG_PRINTK=y
CONFIG_BUG=y
CONFIG_ELF_CORE=y
CONFIG_BASE_FULL=y
CONFIG_FUTEX=y
CONFIG_EPOLL=y
CONFIG_SIGNALFD=y
CONFIG_TIMERFD=y
CONFIG_EVENTFD=y
CONFIG_AIO=y
CONFIG_KALLSYMS=y
CONFIG_BPF_SYSCALL=y
CONFIG_BLK_DEV_INITRD=y
CONFIG_RD_GZIP=y
CONFIG_EXPERT=y
CONFIG_MULTIUSER=y
CONFIG_RUST=y
CONFIG_ARCH_APPLE=y
CONFIG_ARM64_16K_PAGES=y
CONFIG_ARM64_VA_BITS_47=y
CONFIG_NR_CPUS=10
CONFIG_SCHED_MC=y
CONFIG_COMPAT=y
CONFIG_CMDLINE="console=ttySAC0,115200 earlycon=s5l,0x3ad200000 ignore_loglevel nohlt maxcpus=1"
CONFIG_PM=y
CONFIG_BINFMT_ELF=y
CONFIG_BINFMT_SCRIPT=y
CONFIG_DEVTMPFS=y
CONFIG_DEVTMPFS_MOUNT=y
CONFIG_TTY=y
CONFIG_UNIX98_PTYS=y
CONFIG_SERIAL_SAMSUNG=y
CONFIG_SERIAL_SAMSUNG_CONSOLE=y
CONFIG_SERIAL_SAMSUNG_UARTS=1
CONFIG_DRM=y
CONFIG_DRM_ASAHI_M4=y
# CONFIG_DRM_ASAHI is not set
# CONFIG_APPLE_PMP is not set
CONFIG_APPLE_PMGR_PWRSTATE=y
CONFIG_PROC_FS=y
CONFIG_SYSFS=y
CONFIG_TMPFS=y
CONFIG_DEBUG_FS=y
CONFIG_PRINTK_TIME=y
CONFIG_MAGIC_SYSRQ=y
CONFIG_DEBUG_KERNEL=y
CONFIG_DEBUG_INFO_DWARF_TOOLCHAIN_DEFAULT=y
CONFIG_FRAME_POINTER=y

# Focused externally signaled dependency check in the bring-up initramfs.
CONFIG_SYNC_FILE=y
CONFIG_SW_SYNC=y
```

## drivers/gpu/drm/asahi/Kconfig
```kconfig
# SPDX-License-Identifier: GPL-2.0

config RUST_DRM_SCHED
	bool
	select DRM_SCHED

config RUST_DRM_GPUVM
	bool
	select DRM_GPUVM

config DRM_ASAHI
	tristate "Asahi (DRM support for Apple AGX GPUs)"
	depends on RUST
	depends on DRM=y
	depends on (ARM64 && ARCH_APPLE) || (COMPILE_TEST && !GENERIC_ATOMIC64)
	depends on MMU
	depends on IOMMU_SUPPORT
	depends on PAGE_SIZE_16KB
	depends on PM
	select APPLE_MAILBOX
	select APPLE_PMP_REPORT
	select RUST_DRM_SCHED
	select RUST_DRM_GEM_SHMEM_HELPER
	select RUST_DRM_GPUVM
	select RUST_APPLE_RTKIT
	help
	  Rust DRM driver for Apple AGX GPUs in the M1 and M2 SoC families,
	  M4, M4 Max, and A18 Pro (MacBook Neo). Device-tree matching selects
	  the appropriate firmware backend.

config DRM_ASAHI_DEBUG_ALLOCATOR
	bool "Use debug allocator"
	depends on DRM_ASAHI
	help
	  Use an alternate, simpler allocator which significantly reduces
	  performance, but can help find firmware- or GPU-side memory safety
	  issues. However, it can also trigger firmware bugs more easily,
	  so expect GPU crashes.

	  Say N unless you are debugging firmware structures or porting to a
	  new firmware version.
```

## drivers/net/wireless/apple/Kconfig
```kconfig
# SPDX-License-Identifier: GPL-2.0-only
config CENTAURI
	tristate "Apple Centauri Wi-Fi/Bluetooth Rust bring-up driver"
	depends on RUST && ARM64 && OF && PCI && PCI_MSI && BT && CFG80211
	help
	  Rust hardware and DMA queue driver for Apple Centauri PCI functions
	  described by enabled device-tree nodes. The cold path owns firmware
	  image transfer, port reset/removal/rescan, radio queues and interface
	  activation using normal Linux PCI/DMA APIs. Passive 2.4GHz scanning,
	  WPA2/CCMP association with an ordinary supplicant supplying the PMK,
	  SAE/default-PWE or H2E-only with required PMF, and native Ethernet
	  traffic work. H2E-only checks peer RSNXE and rejects observed legacy
	  commits; forced hunting/pecking is unsupported. passive_scan is required
	  for this experimental scan path.
	  Cold Bluetooth generates its own HCI command/event and ACL rings.
	  Firmware inputs are prepared independently outside the driver. Wider
	  protocol coverage, automatic chip-power sequencing and initial host PHY
	  integration remain incomplete.

	  Separate experimental warm Wi-Fi nodes can register Ethernet
	  transports from current-boot typed loader metadata. That older path
	  requires a stopped previous owner and reserved DMA pages, and does not
	  prove independent cold startup or association.
```

## sound/soc/apple/Kconfig
```kconfig
# SPDX-License-Identifier: GPL-2.0-only
menu "Apple"

config SND_SOC_APPLE_AOP_AUDIO
	tristate "AOP audio driver"
	depends on ARCH_APPLE || COMPILE_TEST
	depends on RUST
	select APPLE_AOP
	select SND_DMAENGINE_PCM
	help
	  This option enables an ASoC driver for sound devices connected to the AOP
	  co-processor on ARM Macs. This includes the built-in microphone on those
	  machines.

config SND_SOC_APPLE_MCA
	tristate "Apple Silicon MCA driver"
	depends on ARCH_APPLE || COMPILE_TEST
	select SND_DMAENGINE_PCM
	help
	  This option enables an ASoC platform driver for MCA peripherals found
	  on Apple Silicon SoCs.

config SND_SOC_APPLE_MACAUDIO
	tristate "Sound support for Apple Silicon Macs"
	depends on ARCH_APPLE || COMPILE_TEST
	select SND_SOC_APPLE_MCA
	select SND_SIMPLE_CARD_UTILS
	select APPLE_ADMAC if DMADEVICES
	select COMMON_CLK_APPLE_NCO if COMMON_CLK
	select SND_SOC_TAS2764 if I2C
	select SND_SOC_TAS2770 if I2C
	select SND_SOC_CS42L83 if I2C
	select SND_SOC_CS42L84 if I2C
	select REGULATOR_FIXED_VOLTAGE if REGULATOR
	help
	  This option enables an ASoC machine-level driver for Apple Silicon Macs
	  and it also enables the required SoC and codec drivers for overall
	  sound support on these machines.

config SND_SOC_APPLE_T8132_SPEAKER
	tristate "Experimental T8132 Mac mini internal speaker"
	depends on ARCH_APPLE && ARM64_16K_PAGES && I2C && GPIOLIB && OF
	depends on DMADEVICES
	select SND_PCM
	select SND_SOC_APPLE_MCA
	select SND_SOC_TAS2764
	select APPLE_ADMAC
	help
	  Fixed-format J773g internal-speaker playback with an in-kernel
	  voice-coil thermal model. Samples are attenuated and their energy
	  is charged before they reach the DMA ring, so no userspace daemon
	  or V/I feedback is needed. The amplifier is held at a hardware
	  ceiling set by the ceiling_dvc module parameter.

	  Uses the shared MCA, ADMAC, DART and TAS2764 drivers with J773g
	  routing and protected PCM copies. This driver can be built into
	  the kernel or as the snd-t8132-speaker module.

endmenu
```
