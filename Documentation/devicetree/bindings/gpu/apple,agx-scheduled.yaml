## Documentation/devicetree/bindings/gpu/apple,agx-scheduled.yaml
```yaml
# SPDX-License-Identifier: (GPL-2.0-only OR BSD-2-Clause)
%YAML 1.2
---
$id: http://devicetree.org/schemas/gpu/apple,agx-scheduled.yaml#
$schema: http://devicetree.org/meta-schemas/core.yaml#

title: Apple multi-cluster G16 scheduled GPU (experimental)

maintainers:
  - Sasha Finkelstein <k@chaosmail.tech>

description: |
  Experimental T6040/T6041 support for the macOS 26.6.2 scheduled-work ABI.
  m1n1 fills reserved memory, OPPs and typed board calibration properties.
  The GPU and mailbox power domain must remain always on.

properties:
  compatible:
    oneOf:
      - items:
          - const: apple,agx-t6040
          - enum: ["apple,agx-g16s", "apple,agx-g16c"]
      - items:
          - const: apple,agx-t6041
          - const: apple,agx-g16c
  reg:
    items:
      - description: GPU MMIO
      - description: Firmware ASC registers
  reg-names:
    items:
      - const: sgx
      - const: asc
  mboxes:
    maxItems: 1
  mbox-names:
    items:
      - const: primary
  power-domains:
    maxItems: 1
  operating-points-v2: true
  apple,cs-opp:
    $ref: /schemas/types.yaml#/definitions/phandle
  memory-region:
    minItems: 5
    maxItems: 5
  memory-region-names:
    items:
      - const: ttbs
      - const: pagetables
      - const: l2
      - const: handoff
      - const: firmware
  apple,firmware-build:
    $ref: /schemas/types.yaml#/definitions/string
  apple,rtkit-private-vm-region:
    $ref: /schemas/types.yaml#/definitions/uint64-array
    minItems: 2
    maxItems: 2

required:
  - compatible
  - reg
  - reg-names
  - mboxes
  - mbox-names
  - memory-region
  - memory-region-names
  - operating-points-v2
  - apple,cs-opp

# Board calibration properties are populated by m1n1; their complete binding
# remains experimental alongside this ABI. Linux never consumes the raw ADT.
additionalProperties: true
...
```

## Documentation/devicetree/bindings/hwmon/apple,smc-hwmon.yaml
```yaml
# SPDX-License-Identifier: (GPL-2.0-only OR BSD-2-Clause)
%YAML 1.2
---
$id: http://devicetree.org/schemas/hwmon/apple,smc-hwmon.yaml#
$schema: http://devicetree.org/meta-schemas/core.yaml#

title: Apple SMC Hardware Monitoring

description:
  Apple's System Management Controller (SMC) exposes a vast array of
  hardware monitoring sensors, including temperature probes, current and
  voltage sense, power meters, and fan speeds. It also provides endpoints
  to manually control the speed of each fan individually. Each Apple
  Silicon device exposes a different set of endpoints via SMC keys. This
  is true even when two machines share an SoC. The CPU core temperature
  sensor keys on an M1 Mac mini are different to those on an M1 MacBook
  Pro, for example.

maintainers:
  - James Calligeros <jcalligeros99@gmail.com>

$defs:
  sensor:
    type: object

    properties:
      apple,key-id:
        $ref: /schemas/types.yaml#/definitions/string
        pattern: "^[A-Za-z0-9]{4}$"
        description: The SMC FourCC key of the desired sensor.
          Must match the node's suffix.

      label:
        description: Human-readable name for the sensor

    required:
      - apple,key-id

properties:
  compatible:
    const: apple,smc-hwmon

  '#thermal-sensor-cells':
    const: 0

  apple,thermal-sensor-keys:
    $ref: /schemas/types.yaml#/definitions/string-array
    minItems: 1
    maxItems: 16
    uniqueItems: true
    items:
      pattern: '^T[A-Za-z0-9]{3}$'
    description: |
      Required temperature keys whose maximum is the thermal sensor value.
      The identities are independent of the optional hwmon channel order.
      A matching thermal zone must have passive cooling trips. After three
      failed aggregate reads, the provider uses the highest passive trip as
      a conservative control temperature until three complete reads succeed.
      This fault control value does not replace individual hwmon readings.

dependencies:
  '#thermal-sensor-cells': ['apple,thermal-sensor-keys']
  apple,thermal-sensor-keys: ['#thermal-sensor-cells']

patternProperties:
  "^current-[A-Za-z0-9]{4}$":
    $ref: "#/$defs/sensor"
    unevaluatedProperties: false

  "^fan-[A-Za-z0-9]{4}$":
    $ref: "#/$defs/sensor"
    unevaluatedProperties: false

    properties:
      apple,fan-minimum:
        $ref: /schemas/types.yaml#/definitions/string
        pattern: "^[A-Za-z0-9]{4}$"
        description: SMC key containing the fan's minimum speed

      apple,fan-maximum:
        $ref: /schemas/types.yaml#/definitions/string
        pattern: "^[A-Za-z0-9]{4}$"
        description: SMC key containing the fan's maximum speed

      apple,fan-target:
        $ref: /schemas/types.yaml#/definitions/string
        pattern: "^[A-Za-z0-9]{4}$"
        description: Writeable endpoint for setting desired fan speed

      apple,fan-mode:
        $ref: /schemas/types.yaml#/definitions/string
        pattern: "^[A-Za-z0-9]{4}$"
        description: Writeable key to enable/disable manual fan control

  "^power-[A-Za-z0-9]{4}$":
    $ref: "#/$defs/sensor"
    unevaluatedProperties: false

  "^temperature-[A-Za-z0-9]{4}$":
    $ref: "#/$defs/sensor"
    unevaluatedProperties: false

  "^voltage-[A-Za-z0-9]{4}$":
    $ref: "#/$defs/sensor"
    unevaluatedProperties: false

additionalProperties: false
```

## Documentation/devicetree/bindings/iommu/apple,dart.yaml
```yaml
# SPDX-License-Identifier: (GPL-2.0 OR BSD-2-Clause)
%YAML 1.2
---
$id: http://devicetree.org/schemas/iommu/apple,dart.yaml#
$schema: http://devicetree.org/meta-schemas/core.yaml#

title: Apple DART IOMMU

maintainers:
  - Sven Peter <sven@svenpeter.dev>

description: |+
  Apple SoCs may contain an implementation of their Device Address
  Resolution Table which provides a mandatory layer of address
  translations for various masters.

  Each DART instance is capable of handling up to 16 different streams
  with individual pagetables and page-level read/write protection flags.

  This DART IOMMU also raises interrupts in response to various
  fault conditions.

properties:
  compatible:
    oneOf:
      - enum:
          - apple,t8103-dart
          - apple,t8103-usb4-dart
          - apple,t8110-dart
          - apple,t6000-dart
      - items:
          - enum:
              - apple,t6020-dart
              - apple,t8122-dart
              - apple,t8132-dart
          - const: apple,t8110-dart

  reg:
    maxItems: 1

  interrupts:
    maxItems: 1

  clocks:
    description:
      Reference to the gate clock phandle if required for this IOMMU.
      Optional since not all IOMMUs are attached to a clock gate.

  apple,dma-range:
    $ref: /schemas/types.yaml#/definitions/uint64-array
    minItems: 2
    maxItems: 2
    description:
      Base and size of the usable device address aperture. Firmware may reserve
      the remaining address space or configure bypass windows there.

  '#iommu-cells':
    const: 1
    description:
      Has to be one. The single cell describes the stream id emitted by
      a master to the IOMMU.

  apple,sid-remap:
    $ref: /schemas/types.yaml#/definitions/uint32-matrix
    description: |
      Hardware requestor SID aliases required by this DART's integration.
      Each pair contains a source requestor SID followed by the target
      translation SID whose page tables and access controls it must use.
      Only T8110-compatible DARTs support this mapping; target SIDs are
      limited to the four-bit TCR remap field.

      Aliased requestors cannot be isolated from their target and must share
      its translation context and IOMMU group. A source SID must not also
      appear as a target; self-maps, chains and cycles are not supported.
      SIDs not listed as sources retain identity mapping. Omit this property
      when no hardware requestor aliases are required.
    minItems: 1
    maxItems: 255
    items:
      items:
        - description: Source requestor SID
          maximum: 255
        - description: Target translation SID
          maximum: 15

  power-domains:
    maxItems: 1

required:
  - compatible
  - reg
  - '#iommu-cells'
  - interrupts

allOf:
  - if:
      not:
        properties:
          compatible:
            contains:
              const: apple,t8110-dart
    then:
      properties:
        apple,sid-remap: false

additionalProperties: false

examples:
  - |+
    dart1: iommu@82f80000 {
      compatible = "apple,t8103-dart";
      reg = <0x82f80000 0x4000>;
      interrupts = <1 781 4>;
      #iommu-cells = <1>;
    };

    master1 {
      iommus = <&dart1 0>;
    };

  - |+
    dart2a: iommu@82f00000 {
      compatible = "apple,t8103-dart";
      reg = <0x82f00000 0x4000>;
      interrupts = <1 781 4>;
      #iommu-cells = <1>;
    };
    dart2b: iommu@82f80000 {
      compatible = "apple,t8103-dart";
      reg = <0x82f80000 0x4000>;
      interrupts = <1 781 4>;
      #iommu-cells = <1>;
    };

    master2 {
      iommus = <&dart2a 0>, <&dart2b 1>;
    };
```

## Documentation/devicetree/bindings/net/apple,centauri-control.yaml
```yaml
# SPDX-License-Identifier: GPL-2.0-only
%YAML 1.2
---
$id: http://devicetree.org/schemas/net/apple,centauri-control.yaml#
$schema: http://devicetree.org/meta-schemas/core.yaml#

title: Apple T2026 Centauri shared control PCI function

maintainers:
  - Cody Ho <codyho@stanford.edu>

description: |
  Centauri's physical control function changes its PCI device identity from
  106b:1900 during bootstrap to 106b:1901 after loading the first image and
  restarting the link. The same firmware node describes both states. The
  runtime endpoint also exposes separate Wi-Fi and Bluetooth functions.

  The control function loads an external signed FTAB container. MSI routing
  and IOMMU translation are described by the PCI host. It does not consume a
  reserved-memory firmware or queue handoff from an earlier wireless driver.

allOf:
  - $ref: /schemas/pci/pci-device.yaml

select:
  properties:
    compatible:
      contains:
        const: apple,t2026-centauri-control
  required:
    - compatible

properties:
  compatible:
    items:
      - const: apple,t2026-centauri-control
      - const: pci106b,1900
      - const: pci106b,1901

  reg:
    maxItems: 1

  firmware-name:
    $ref: /schemas/types.yaml#/definitions/string
    description: External signed FTAB image with the required device inputs.

  apple,host-platform-id:
    $ref: /schemas/types.yaml#/definitions/uint32
    minimum: 1
    description: |
      Host platform identity published to the bootstrap interface. Bits31:16
      encode the host board ID and bits15:0 encode the host chip ID, matching
      the image manifest's ApBoardID and ApChipID. This is the host platform,
      not the separate wireless chip/board identity exposed by the endpoint.

required:
  - compatible
  - reg
  - firmware-name
  - apple,host-platform-id

unevaluatedProperties: false
```

## Documentation/devicetree/bindings/net/apple,centauri-pci.yaml
```yaml
# SPDX-License-Identifier: GPL-2.0-only
%YAML 1.2
---
$id: http://devicetree.org/schemas/net/apple,centauri-pci.yaml#
$schema: http://devicetree.org/meta-schemas/core.yaml#

title: Apple Centauri PCI Wi-Fi and Bluetooth firmware handoff

maintainers:
  - Cody Ho <codyho@stanford.edu>

description: |
  Centauri is a multifunction PCIe endpoint. Function 0 (106b:1901) provides
  shared control, function 1 (106b:1902) provides Wi-Fi, and function 2
  (106b:1903) provides Bluetooth. Function identification and BAR assignment
  use standard PCI enumeration; no board model or serial number is required.

  This initial binding describes the firmware-initialized polling transport.
  The bootloader owns PCIe clocks, PHY, reset, MSI setup, firmware startup,
  and DART translations. The host can be described with the standard generic
  ECAM binding once initialized. Do not enable the native DART driver for the
  retained domains: reinitializing them would destroy live firmware mappings.

  Each function references immutable host-generated current-boot queue metadata
  in reserved memory. This is neither executable firmware nor captured packet
  replay. The reserved memory must have a fixed reg provided by the loader,
  must contain the matching CENH0001 (Wi-Fi) or CENB0002 (Bluetooth) header,
  and must remain normal RAM (no no-map property). The metadata contains its
  own byte length and nonce. The DMA allocations it references must also be
  reserved. The driver checks addresses against PCI and DT resources.

# Native cold functions use a chip compatible followed by the PCI identity.
# Select only the legacy single-compatible handoff nodes for this schema.
select:
  properties:
    compatible:
      contains:
        enum:
          - pci106b,1902
          - pci106b,1903
      maxItems: 1
  required:
    - compatible

properties:
  compatible:
    enum:
      - pci106b,1902
      - pci106b,1903

  reg:
    maxItems: 1

  memory-region:
    maxItems: 1
    description: Reserved immutable current-boot queue handoff metadata.

  apple,firmware-dart:
    $ref: /schemas/types.yaml#/definitions/phandle
    description: |
      Reference to the firmware-owned DART hardware node, kept disabled to
      prevent Linux from taking over its live domains. The transport reads
      only error status at offset 0x100 of its first reg resource. This is
      not an IOMMU attachment and must not be combined with Linux ownership
      of these same translation domains. Native DMA/IOMMU ownership is future
      work; SID allocation is not inferred from this phandle.

  local-mac-address:
    $ref: /schemas/types.yaml#/definitions/uint8-array
    minItems: 6
    maxItems: 6
    description: |
      Factory address copied by the loader from the ADT. The associated Wi-Fi
      station may currently use a randomized address in its queue handoff.

required:
  - compatible
  - reg
  - apple,firmware-dart

additionalProperties: false

allOf:
  - if:
      properties:
        status:
          const: disabled
      required:
        - status
    then: {}
    else:
      required:
        - memory-region
```

## Documentation/devicetree/bindings/net/apple,centauri-radio.yaml
```yaml
# SPDX-License-Identifier: GPL-2.0-only
%YAML 1.2
---
$id: http://devicetree.org/schemas/net/apple,centauri-radio.yaml#
$schema: http://devicetree.org/meta-schemas/core.yaml#

title: Apple T2026 Centauri radio PCI function

maintainers:
  - Cody Ho <codyho@stanford.edu>

description: |
  The Wi-Fi function consumes a resource produced by the shared control
  function's current firmware boot. It owns its coherent DMA resources and
  context through the ordinary PCI/IOMMU interfaces, without a reserved-memory
  queue handoff. The control supplier must remain bound during radio use.
  This experimental binding describes cold initialization, not a live context
  supplied by an earlier driver.

allOf:
  - $ref: /schemas/pci/pci-device.yaml

select:
  properties:
    compatible:
      contains:
        const: apple,t2026-centauri-wifi
  required:
    - compatible

properties:
  compatible:
    items:
      - const: apple,t2026-centauri-wifi
      - const: pci106b,1902

  reg:
    maxItems: 1

  apple,control:
    $ref: /schemas/types.yaml#/definitions/phandle
    description: Shared Centauri control function on the same PCI device.

  local-mac-address:
    $ref: /schemas/types.yaml#/definitions/uint8-array
    minItems: 6
    maxItems: 6
    description: Factory address supplied by platform firmware for this device.

required:
  - compatible
  - reg
  - apple,control

unevaluatedProperties: false
```
