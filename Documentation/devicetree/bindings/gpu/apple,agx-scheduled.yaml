## Documentation/devicetree/bindings/net/bluetooth/apple,centauri.yaml
```yaml
# SPDX-License-Identifier: GPL-2.0-only
%YAML 1.2
---
$id: http://devicetree.org/schemas/net/bluetooth/apple,centauri.yaml#
$schema: http://devicetree.org/meta-schemas/core.yaml#

title: Apple T2026 Centauri Bluetooth PCI function

maintainers:
  - Cody Ho <codyho@stanford.edu>

description: |
  The Bluetooth function shares firmware with the Centauri control function.
  It consumes a resource from the current control firmware boot and generates
  its own context and HCI rings in normal coherent DMA memory. The supplier
  remains bound while Bluetooth is in use. No reserved-memory handoff is used.
  This binding is experimental pending complete power and reprobe integration.

allOf:
  - $ref: /schemas/pci/pci-device.yaml

select:
  properties:
    compatible:
      contains:
        const: apple,t2026-centauri-bluetooth
  required:
    - compatible

properties:
  compatible:
    items:
      - const: apple,t2026-centauri-bluetooth
      - const: pci106b,1903

  reg:
    maxItems: 1

  apple,control:
    $ref: /schemas/types.yaml#/definitions/phandle
    description: Shared Centauri control function on the same PCI device.

  local-bd-address:
    $ref: /schemas/types.yaml#/definitions/uint8-array
    minItems: 6
    maxItems: 6
    description: Factory Bluetooth address in little-endian HCI byte order.

required:
  - compatible
  - reg
  - apple,control
  - local-bd-address

unevaluatedProperties: false
```

## Documentation/devicetree/bindings/power/apple,pmp-report.yaml
```yaml
# SPDX-License-Identifier: GPL-2.0-only
%YAML 1.2
---
$id: http://devicetree.org/schemas/power/apple,pmp-report.yaml#
$schema: http://devicetree.org/meta-schemas/core.yaml#

title: Apple Power Management Processor power-state reports

maintainers:
  - Cody Ho <codyho@stanford.edu>

description: |
  The application processor reports power-domain transitions to PMP through
  a shared register aperture. Each child represents one reported domain.
  Some firmware device records describe notifications without an
  acknowledgement guarantee; their observed state must not be polled as a
  prerequisite to starting the device.

properties:
  compatible:
    oneOf:
      - enum:
          - apple,t6000-pmp-v2-report
          - apple,t6020-pmp-v2-report
          - apple,t6030-pmp-v2-report
          - apple,t6041-pmp-v2-report
          - apple,t8112-pmp-v2-report
          - apple,t8122-pmp-v2-report
          - apple,t8140-pmp-v2-report
      - items:
          - const: apple,t6031-pmp-v2-report
          - const: apple,t6020-pmp-v2-report

  reg:
    maxItems: 1

  power-domains:
    maxItems: 1

  "#address-cells":
    const: 1

  "#size-cells":
    const: 0

  apple,pmp:
    $ref: /schemas/types.yaml#/definitions/phandle
    description: |
      PMP controller providing the firmware device table. The bootloader
      transfers the version-1 table in apple,tunable-soc-device and its
      little-endian version in apple,tunable-ptd-driver-version. Records are
      124 bytes; the little-endian flags word at byte 8 has bit 1 set for
      records that require an acknowledgement. When this reference is
      present, child reg values are device-table record indices, and only
      records carrying that flag are polled. Without the reference, existing
      platform report numbering and acknowledgement behaviour are retained.
      A disabled controller without firmware metadata also retains the
      existing ready-bit check, allowing operation without PMP firmware.

patternProperties:
  "^report@[0-9a-f]+$":
    type: object
    allOf:
      - $ref: power-domain.yaml#
    properties:
      compatible:
        oneOf:
          - const: apple,t6000-pmp-v2-report-entry
          - items:
              - enum:
                  - apple,t6020-pmp-v2-report-entry
                  - apple,t6030-pmp-v2-report-entry
                  - apple,t6031-pmp-v2-report-entry
                  - apple,t8112-pmp-v2-report-entry
                  - apple,t8122-pmp-v2-report-entry
              - const: apple,t6000-pmp-v2-report-entry

      reg:
        maxItems: 1

      label: true

      "#power-domain-cells":
        const: 0

      power-domains: true

      apple,always-on:
        type: boolean
        description: Keep the reported domain enabled.

    required:
      - compatible
      - reg
      - label
      - "#power-domain-cells"

    additionalProperties: false

required:
  - compatible
  - reg
  - "#address-cells"
  - "#size-cells"

additionalProperties: false

examples:
  - |
    soc {
        #address-cells = <2>;
        #size-cells = <2>;

        pmp-report@3003c0000 {
            compatible = "apple,t8140-pmp-v2-report";
            reg = <0x3 0x003c0000 0x0 0x30000>;
            apple,pmp = <&pmp>;
            #address-cells = <1>;
            #size-cells = <0>;

            report@b {
                compatible = "apple,t6000-pmp-v2-report-entry";
                reg = <11>;
                label = "pmp-isp";
                #power-domain-cells = <0>;
                power-domains = <&ps_isp_sys>;
            };
        };
    };
```

## Documentation/devicetree/bindings/sound/apple,j713-headphones.yaml
```yaml
# SPDX-License-Identifier: (GPL-2.0-only OR BSD-2-Clause)
%YAML 1.2
---
$id: http://devicetree.org/schemas/sound/apple,j713-headphones.yaml#
$schema: http://devicetree.org/meta-schemas/core.yaml#

title: Apple J713 headphone sound card

maintainers:
  - Niklas Sheth <hi@niklassheth.com>

description: |
  Headphone-only sound card for the T8132 MacBook Air J713. MCA frontend and
  port 2 drive a CS42L84 headphone codec using ADMAC TX2. Speaker amplifiers
  and microphone capture are not part of this card.

properties:
  compatible:
    const: apple,j713-headphones

  apple,mca:
    $ref: /schemas/types.yaml#/definitions/phandle
    description: MCA controller providing frontend and port 2.

  apple,headphone-codec:
    $ref: /schemas/types.yaml#/definitions/phandle
    description: CS42L84 headphone codec.

required:
  - compatible
  - apple,mca
  - apple,headphone-codec

additionalProperties: false

examples:
  - |
    sound {
        compatible = "apple,j713-headphones";
        apple,mca = <&mca>;
        apple,headphone-codec = <&jack_codec>;
    };
```

## Documentation/devicetree/bindings/sound/apple,j773g-speaker.yaml
```yaml
# SPDX-License-Identifier: (GPL-2.0-only OR BSD-2-Clause)
%YAML 1.2
---
$id: http://devicetree.org/schemas/sound/apple,j773g-speaker.yaml#
$schema: http://devicetree.org/meta-schemas/core.yaml#

title: Apple J773g internal speaker

maintainers:
  - Niklas Sheth <hi@niklassheth.com>

description: |
  Mono internal speaker on the M4 Mac mini, using MCA TX0 and an SN012776
  amplifier. The machine driver limits playback with an in-kernel thermal model while
  MCA, ADMAC, DART and TAS2764 provide the hardware interfaces.

properties:
  compatible:
    const: apple,j773g-speaker

  apple,mca:
    $ref: /schemas/types.yaml#/definitions/phandle
    description: MCA controller carrying the internal speaker on TX0.

  apple,codec:
    $ref: /schemas/types.yaml#/definitions/phandle
    description: SN012776 amplifier on the speaker I2C bus.

required:
  - compatible
  - apple,mca
  - apple,codec

additionalProperties: false
```

## Documentation/devicetree/bindings/sound/apple,mca.yaml
```yaml
# SPDX-License-Identifier: (GPL-2.0-only OR BSD-2-Clause)
%YAML 1.2
---
$id: http://devicetree.org/schemas/sound/apple,mca.yaml#
$schema: http://devicetree.org/meta-schemas/core.yaml#

title: Apple MCA I2S transceiver

description: |
  MCA is an I2S transceiver peripheral found on M1 and other Apple chips.
  T8132 uses a single banked aperture; currently only its TX0 route is exposed.
  Earlier hardware is composed of a number of identical clusters which can
  operate independently or in an interlinked fashion. Up to 6 clusters have
  been seen on an MCA.

maintainers:
  - Martin Povišer <povik+lin@cutebit.org>

allOf:
  - $ref: dai-common.yaml#
  - if:
      properties:
        compatible:
          contains:
            const: apple,t8132-mca
    then:
      properties:
        reg:
          maxItems: 1
        dmas:
          maxItems: 1
        dma-names:
          maxItems: 1
        clocks:
          maxItems: 1
        power-domains:
          maxItems: 2
    else:
      properties:
        reg:
          minItems: 2
        dmas:
          minItems: 16
        dma-names:
          minItems: 16
        clocks:
          minItems: 4
        power-domains:
          minItems: 5

properties:
  compatible:
    oneOf:
      - const: apple,t8132-mca
      - items:
          - const: apple,t6020-mca
          - const: apple,t8103-mca
      - items:
          - enum:
              # Do not add additional SoC to this list.
              - apple,t6000-mca
              - apple,t8103-mca
              - apple,t8112-mca
          - const: apple,mca

  reg:
    minItems: 1
    items:
      - description: Register region of the MCA clusters proper
      - description: Register region of the DMA glue and its FIFOs

  interrupts:
    minItems: 4
    maxItems: 6
    description:
      One interrupt per each cluster

  '#address-cells':
    const: 1

  '#size-cells':
    const: 0

  dmas:
    minItems: 1
    maxItems: 24
    description:
      DMA channels corresponding to the SERDES units in the peripheral. They are
      listed in groups of four per cluster, and within the group they are given
      as associated to the TXA, RXA, TXB, RXB units.

  dma-names:
    minItems: 1
    items:
      - const: tx0a
      - const: rx0a
      - const: tx0b
      - const: rx0b
      - const: tx1a
      - const: rx1a
      - const: tx1b
      - const: rx1b
      - const: tx2a
      - const: rx2a
      - const: tx2b
      - const: rx2b
      - const: tx3a
      - const: rx3a
      - const: tx3b
      - const: rx3b
      - const: tx4a
      - const: rx4a
      - const: tx4b
      - const: rx4b
      - const: tx5a
      - const: rx5a
      - const: tx5b
      - const: rx5b
    description: |
      Names for the DMA channels: 'tx'/'rx', then cluster number, then 'a'/'b'
      based on the associated SERDES unit.

  clocks:
    minItems: 1
    maxItems: 6
    description:
      Clusters' input reference clock.

  resets:
    maxItems: 1

  power-domains:
    minItems: 2
    maxItems: 7
    description:
      First a general power domain for register access, then the power
      domains of individual clusters for their operation.

  '#sound-dai-cells':
    const: 1

required:
  - compatible
  - reg
  - dmas
  - dma-names
  - clocks
  - power-domains
  - '#sound-dai-cells'

unevaluatedProperties: false

examples:
  - |
    mca: i2s@9b600000 {
      compatible = "apple,t6000-mca", "apple,mca";
      reg = <0x9b600000 0x10000>,
            <0x9b200000 0x20000>;

      clocks = <&nco 0>, <&nco 1>, <&nco 2>, <&nco 3>;
      power-domains = <&ps_audio_p>, <&ps_mca0>, <&ps_mca1>,
                      <&ps_mca2>, <&ps_mca3>;
      dmas = <&admac 0>, <&admac 1>, <&admac 2>, <&admac 3>,
             <&admac 4>, <&admac 5>, <&admac 6>, <&admac 7>,
             <&admac 8>, <&admac 9>, <&admac 10>, <&admac 11>,
             <&admac 12>, <&admac 13>, <&admac 14>, <&admac 15>;
      dma-names = "tx0a", "rx0a", "tx0b", "rx0b",
                  "tx1a", "rx1a", "tx1b", "rx1b",
                  "tx2a", "rx2a", "tx2b", "rx2b",
                  "tx3a", "rx3a", "tx3b", "rx3b";

      #sound-dai-cells = <1>;
    };
```
